## boards/nordic/nrf54l15/Kconfig.nrf54l15
```kconfig
config BOARD_NRF54L15
	select SOC_NRF54L15_CPUAPP if BOARD_NRF54L15_NRF54L15_CPUAPP
	select SOC_NRF54L15_CPUFLPR if \
		BOARD_NRF54L15_NRF54L15_CPUFLPR || \
		BOARD_NRF54L15_NRF54L15_CPUFLPR_XIP
```

## boards/nordic/nrf54l15/board.yml
```yaml
board:
  name: nrf54l15
  vendor: nordic
  socs:
  - name: nrf54l15
    variants:
    - name: xip
      cpucluster: cpuflpr
```
